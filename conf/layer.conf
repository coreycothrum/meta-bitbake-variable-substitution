## conf/layer.conf
```bitbake
# We have a conf and classes directory, add to BBPATH
BBPATH .= ":${LAYERDIR}"

# We have recipes-* directories, add to BBFILES
BBFILES += "${LAYERDIR}/recipes-*/*/*.bb \
            ${LAYERDIR}/recipes-*/*/*.bbappend"

BBFILE_COLLECTIONS += "bitbake-variable-substitution"
BBFILE_PATTERN_bitbake-variable-substitution = "^${LAYERDIR}/"

INHERIT += "bitbake-variable-substitution-vars"

LAYERDEPENDS_bitbake-variable-substitution = "core"
LAYERSERIES_COMPAT_bitbake-variable-substitution = "kirkstone scarthgap"
```
